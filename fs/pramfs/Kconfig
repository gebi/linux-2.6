## fs/pramfs/Kconfig
```kconfig
config PRAMFS
	tristate "Persistent and Protected RAM file system support"
	depends on EXPERIMENTAL
	help
	   If your system has a block of fast (comparable in access speed to
	   system memory) and non-volatile RAM and you wish to mount a
	   light-weight, full-featured, and space-efficient filesystem over it,
	   say Y here, and read <file:Documentation/filesystems/pramfs.txt>.

	   To compile this as a module,  choose M here: the module will be
	   called pramfs.ko.

config PRAMFS_XIP
	bool "Enable Execute-in-place in PRAMFS"
	depends on PRAMFS && !PRAMFS_WRITE_PROTECT
	help
	   Say Y here to enable xip feature of PRAMFS.

config PRAMFS_WRITE_PROTECT
	bool "Enable PRAMFS write protection"
	depends on PRAMFS && MMU
	default y
	help
	   Say Y here to enable the write protect feature of PRAMFS.

config PRAMFS_TEST
	boolean
	depends on PRAMFS

config TEST_MODULE
	tristate "PRAMFS Test"
	depends on PRAMFS && m
	select PRAMFS_TEST
	help
	  Say Y here to build a simple module to test the protection of
	  PRAMFS. The module will be called pramfs_test.ko.
```

## init/Kconfig.cpu
```kconfig
choice
	prompt "ZenSched CPU Scheduler Choice"
	default CPU_BFS
	help
	  Here you can choose the CPU scheduler to be compiled with the kernel.

	  If unsure, say CPU_BFS

config CPU_CFS
	bool "Completely Fair Scheduler (CFS)"
	help
	  The "Completely Fair Scheduler" (CFS), developed by Ingo Molnar,
	  is the CPU scheduler used in the default vanilla kernel.

config CPU_BFS
	bool "Brainfuck Scheduler (BFS)"
	help
	  The "Brainfuck Scheduler" (BFS) is a CPU scheduler developed
	  by Con Kolivas. It is designed for ultra low latency and excellent
	  desktop performance.

	  Not recommended for 4096 CPUs

endchoice

config CPU_BFS_AUTOISO
        bool "Auto SCHED_ISO for X"
        depends on CPU_BFS
        help
	  Tasks (including X) can be run as SCHED_ISO manually with schedtool -I
	  Enable this to automatically run SCHED_ISO for X, this is not default
	  because there is a slim possibility that other tasks (such as multimedia)
	  may stutter if they aren't also ran as SCHED_ISO.

	  If unsure, say N here

config CFS_BOOST
	bool "Boost X Privilege"
	default y
	depends on CPU_CFS
	help
	  This option instructs the kernel to guarantee more CPU time to
	  X than to other tasks, which is sueful if you want to have a
	  faster desktop even under high system load.

	  This option works by automatically boosting X's priority via
	  renicing it to -10. NOTE: CFS does not suffer from
	  "overscheduling" problems when X is reniced to -10, so if this
	  is a predominantly desktop box it makes sense to select this option

	  Say Y here if you are building a kernel for a desktop system.
	  Say N here if you want X to be treated as a normal task.

config CFS_BOOST_NICE
	int "Nice value for privileged tasks"
	depends on CFS_BOOST
	range -20 19
	default -10
```
